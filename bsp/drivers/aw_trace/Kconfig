## bsp/drivers/aw_trace/Kconfig
```kconfig
# SPDX-License-Identifier: GPL-2.0-only

menu "Aw trace Drivers"
	depends on AW_BSP

config AW_TRACE
	tristate "Allwinner Tracers"
	depends on AW_BSP
	help
	  Support for aw tracers for debug.

endmenu
```

## bsp/drivers/thermal/Kconfig
```kconfig
# SPDX-License-Identifier: GPL-2.0-only
menu "Thermal Drivers"
	depends on AW_BSP

config AW_THERMAL
	tristate "Allwinner Thermal Driver"
	depends on AW_BSP
	depends on HAS_IOMEM
	depends on NVMEM
	depends on OF
	select THERMAL
	help
	  Support for the sunxi thermal sensor driver into the Linux thermal
	  framework.

	  To compile this driver as a module, choose M here: the
	  module will be called sunxi-thermal.

config AW_CPUFREQ_CLAMP
	tristate "Allwinner Cpufreq Clamp Driver"
	depends on AW_THERMAL
	depends on ARM_AW_SUN50I_CPUFREQ_NVMEM
	help
	  Support for the sunxi cpufreq clamp driver.

	  If in doubt, say N.

endmenu
```

## bsp/drivers/video/sunxi/disp2/hdmi_it6807/Kconfig
```kconfig
# SPDX-License-Identifier: GPL-2.0

config IT6807_HDMI_VBYONE
tristate "IT6807 Driver Support(ITE)"
default n
help
This is external hdmi switch vbyone chip driver.

config IT6807_HDMI_VBYONE_DEBUG
	bool "debugfs support for it6807"
	depends on IT6807_HDMI_VBYONE
	default y
	help
	  This enable debugfs support for it6807 driver. You can
	  get debug info or debug the driver via debugfs interface.
```
