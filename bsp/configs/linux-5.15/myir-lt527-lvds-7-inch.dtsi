/*
 * MYiR Technology CO., Ltd.
 */

&disp {
        disp_init_enable         = <1>;
        disp_mode                = <0>;

        screen0_output_type      = <1>;
        screen0_output_mode      = <4>;
        screen0_to_lcd_index     = <0>;

        screen1_output_type      = <1>;
        screen1_output_mode      = <4>;
        screen1_to_lcd_index     = <1>;

        screen1_output_format    = <0>;
        screen1_output_bits      = <0>;
        screen1_output_eotf      = <4>;
        screen1_output_cs        = <257>;
        screen1_output_dvi_hdmi  = <2>;
        screen1_output_range     = <2>;
        screen1_output_scan      = <0>;
        screen1_output_aspect_ratio = <8>;

		dev_num                  = <2>;
        dev0_output_type         = <1>;
        dev0_output_mode         = <4>;
        dev0_screen_id           = <0>;
        dev0_do_hpd              = <0>;

        dev1_output_type         = <1>;
        dev1_output_mode         = <4>;
        dev1_screen_id           = <1>;
        dev1_do_hpd              = <1>;

        def_output_dev           = <0>;
        hdmi_mode_check          = <1>;

        display_device_num          = <3>;

        primary_display_type        = "LCD";
        primary_de_id               = <0>;
        primary_framebuffer_width   = <1280>;
        primary_framebuffer_height  = <800>;
        primary_dpix                = <213>;
        primary_dpiy                = <213>;

        extend0_display_type        = "HDMI";
        extend0_de_id               = <1>;
        extend0_framebuffer_width   = <1920>;
        extend0_framebuffer_height  = <1080>;
        extend0_dpix                = <160>;
        extend0_dpiy                = <160>;

        extend1_display_type        = "DP";
        extend1_de_id               = <1>;
        extend1_framebuffer_width   = <1920>;
        extend1_framebuffer_height  = <1080>;
        extend1_dpix                = <160>;
        extend1_dpiy                = <160>;

        fb_format                = <0>;
        fb_num                   = <2>;
        /*<disp channel layer zorder>*/
        fb0_map                  = <0 1 0 16>;
        fb0_width                = <1280>;
        fb0_height               = <800>;
        /*<disp channel layer zorder>*/
        fb1_map                  = <1 1 0 16>;
        fb1_width                = <1920>;
        fb1_height               = <1080>;
        /*<disp channel layer zorder>*/
        fb2_map                  = <1 0 0 16>;
        fb2_width                = <1920>;
        fb2_height               = <1080>;
        /*<disp channel layer zorder>*/
        fb3_map                  = <1 1 0 16>;
        fb3_width                = <300>;
        fb3_height               = <300>;

        chn_cfg_mode             = <3>;
        disp_para_zone           = <1>;

        /* dual display clock constraints:
           1. two tcons cannot share a parent clock.
           2. when dsi uses ccu clock, combphy and corresponding tcon use the
            same parent clock.
        */
        assigned-clocks = <&ccu CLK_DE>,
                  <&ccu CLK_VO0_TCONLCD0>,
                  <&ccu CLK_VO0_TCONLCD1>,
                  <&ccu CLK_VO1_TCONLCD0>,
                  <&ccu CLK_TCONTV>,
                  <&ccu CLK_TCONTV1>,
                  <&ccu CLK_COMBPHY0>,
                  <&ccu CLK_COMBPHY1>,
                  <&ccu CLK_DSI0>,
                  <&ccu CLK_DSI1>,
                  <&ccu CLK_EDP>;
        assigned-clock-parents = <&ccu CLK_PLL_VIDEO3_4X>,
                         <&ccu CLK_PLL_VIDEO0_4X>,
                         <&ccu CLK_PLL_VIDEO1_4X>,
                         <&ccu CLK_PLL_VIDEO1_4X>,
                         <&ccu CLK_PLL_VIDEO1_4X>,
                         <&ccu CLK_PLL_VIDEO1_4X>,
                         <&ccu CLK_PLL_VIDEO0_4X>,
                         <&ccu CLK_PLL_VIDEO1_4X>,
                         <&ccu CLK_PLL_PERI0_150M>,
                         <&ccu CLK_PLL_PERI0_150M>,
                         <&ccu CLK_PLL_VIDEO1_4X>;
        assigned-clock-rates = <600000000>;

        cldo3-supply = <&reg_cldo3>;
        dcdc4-supply = <&reg_dcdc4>;
        cldo1-supply = <&reg_cldo1>;

		pwms = <&pwm0 10 5000000 0>, <&pwm0 5 5000000 0>;
		pwm-names = "lvds0_backlight", "lvds2_backlight";

		power-domains = <&pd1 A523_PCK_DE>, <&pd1 A523_PCK_VO0>, <&pd1 A523_PCK_VO1>;
		power-domain-names = "pd_de", "pd_vo0", "pd_vo1";

		pinctrl-names = "active", "sleep";
		pinctrl-0 = <&pwm0_10_pin_active>;
		pinctrl-1 = <&pwm0_10_pin_sleep>;
};

&lcd0 {
		lcd_used            = <1>;
        lcd_driver_name     = "default_lcd";
        lcd_backlight       = <200>;
        lcd_if              = <3>;

		lcd_x               = <1024>;
		lcd_y               = <600>;
		lcd_width           = <154>;
		lcd_height          = <86>;
		lcd_dclk_freq       = <52>;

		lcd_hbp             = <162>;
		lcd_ht              = <1324>;
		lcd_hspw            = <116>;
		lcd_vbp             = <24>;
		lcd_vt              = <629>;
		lcd_vspw            = <3>;

        lcd_pwm_used        = <1>;
        lcd_pwm_ch          = <10>;
        lcd_pwm_freq        = <10000000>;
        lcd_pwm_pol         = <0>;
        lcd_pwm_max_limit   = <255>;
		lcd_pwm_name	    = "lvds0_backlight";

        lcd_lvds_if         = <0>;
        lcd_lvds_colordepth = <0>;
        lcd_lvds_mode       = <0>;
        lcd_frm             = <0>;
        lcd_hv_clk_phase    = <0>;
        lcd_hv_sync_polarity= <0>;
        lcd_gamma_en        = <0>;
        lcd_bright_curve_en = <0>;
        lcd_cmap_en         = <0>;
        lcd_fsync_en        = <0>;
		lcd_fsync_act_time  = <1000>;
		lcd_fsync_dis_time  = <1000>;
        lcd_fsync_pol       = <0>;
		lcd_start_delay     = <5>;
        deu_mode            = <0>;
        lcdgamma4iep        = <22>;
        smart_color         = <90>;

        lcd_pin_power = "cldo3";
        lcd_power = "dcdc4";
        lcd_power1 = "cldo1";

        pinctrl-0 = <&lvds0_pins_a>;
        pinctrl-1 = <&lvds0_pins_b>;
};
