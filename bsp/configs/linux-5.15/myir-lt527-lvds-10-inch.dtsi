/*
 * MYiR Technology CO., Ltd.
 */

&lcd0 {
		lcd_used            = <1>;
        lcd_driver_name     = "bp101wx1";
        lcd_backlight       = <200>;
        lcd_if              = <3>;

		lcd_x               = <1280>;
		lcd_y               = <800>;
		lcd_width           = <150>;
		lcd_height          = <94>;
		lcd_dclk_freq       = <63>;

        lcd_hbp             = <88>;
        lcd_ht              = <1451>;
        lcd_hspw            = <18>;
        lcd_vbp             = <23>;
        lcd_vt              = <860>;
        lcd_vspw            = <10>;

        lcd_pwm_used        = <1>;
        lcd_pwm_ch          = <10>;
        lcd_pwm_freq        = <50000>;
        lcd_pwm_pol         = <0>;
        lcd_pwm_max_limit   = <255>;
		lcd_pwm_name	    = "lvds0_backlight";

        lcd_lvds_if         = <0>;
        lcd_lvds_colordepth = <0>;
        lcd_lvds_mode       = <0>;
        lcd_frm             = <1>;
        lcd_hv_clk_phase    = <0>;
        lcd_hv_sync_polarity= <0>;
        lcd_gamma_en        = <0>;
        lcd_bright_curve_en = <0>;
        lcd_cmap_en         = <0>;
        lcd_fsync_en        = <0>;
		lcd_fsync_act_time  = <1000>;
		lcd_fsync_dis_time  = <1000>;
        lcd_fsync_pol       = <0>;
		lcd_start_delay     = <5>;
        deu_mode            = <0>;
        lcdgamma4iep        = <22>;
        smart_color         = <90>;

        lcd_pin_power = "cldo3";
        lcd_power = "dcdc4";
        lcd_power1 = "cldo1";

        pinctrl-0 = <&lvds0_pins_a>;
        pinctrl-1 = <&lvds0_pins_b>;
};


